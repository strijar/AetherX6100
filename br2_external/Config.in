## br2_external/Config.in
```kconfig
source "$BR2_EXTERNAL_X6100_PATH/package/panel-jinglitai-jlt4013a/Config.in"
source "$BR2_EXTERNAL_X6100_PATH/package/aether-x6100-control/Config.in"
```

## br2_external/board/X6100/u-boot/sun8i-r16-x6100_defconfig
```kconfig
CONFIG_ARM=y
CONFIG_ARCH_SUNXI=y
CONFIG_CONS_INDEX=1
CONFIG_IDENT_STRING=""
CONFIG_MACH_SUN8I_A33=y
CONFIG_DRAM_CLK=432
CONFIG_DRAM_ZQ=15291
CONFIG_MMC0_CD_PIN="PE3"
CONFIG_MMC_SUNXI_SLOT_EXTRA=2
CONFIG_USB0_ID_DET="PH8"
CONFIG_VIDEO_LCD_MODE="x:480,y:854,depth:18,pclk_khz:27500,le:12,ri:38,up:4,lo:18,hs:12,vs:8,sync:3,vmode:0"
CONFIG_VIDEO_LCD_DCLK_PHASE=0
CONFIG_VIDEO_LCD_RESET="PL11"
CONFIG_VIDEO_LCD_BL_EN="PL6"
CONFIG_VIDEO_LCD_BL_PWM="PH0"
CONFIG_SPL_FAT_SUPPORT=y
CONFIG_DEFAULT_DEVICE_TREE="sun8i-r16-x6100"
# CONFIG_SYS_MALLOC_CLEAR_ON_INIT is not set
# CONFIG_DISPLAY_CPUINFO is not set
# CONFIG_DISPLAY_BOARDINFO is not set
CONFIG_SPL=y
CONFIG_CMD_DFU=y
# CONFIG_CMD_FLASH is not set
# CONFIG_CMD_FPGA is not set
# CONFIG_SPL_DOS_PARTITION is not set
# CONFIG_SPL_ISO_PARTITION is not set
# CONFIG_SPL_PARTITION_UUIDS is not set
CONFIG_DFU_RAM=y
CONFIG_AXP_DCDC1_VOLT=3300
CONFIG_USB_EHCI_HCD=y
CONFIG_USB_MUSB_GADGET=y
CONFIG_SYS_USB_EVENT_POLL_VIA_INT_QUEUE=y
CONFIG_SYS_WHITE_ON_BLACK=y
CONFIG_CFB_CONSOLE_ANSI=y
# CONFIG_VIDEO_DT_SIMPLEFB is not set
```

## br2_external/package/rhvoice/Config.in
```kconfig
config BR2_PACKAGE_RHVOICE
	bool "RHVoice"
	help
	  RHVoice is a free and open-source speech synthesizer.

	  Initially, RHVoice could speak only Russian. Now it also supports:

	  * American and Scottish English
	  * Brazilian Portuguese
	  * Esperanto
	  * Georgian
	  * Ukrainian
	  * Kyrgyz
	  * Tatar
	  * Macedonian
	  * Albanian
	  * Polish
```
